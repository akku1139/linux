## Documentation/devicetree/bindings/clock/mediatek,mt6757-clock.yaml
```yaml
# SPDX-License-Identifier: (GPL-2.0 OR BSD-2-Clause)
%YAML 1.2
---
$id: http://devicetree.org/schemas/clock/mediatek,mt6757-clock.yaml#
$schema: http://devicetree.org/meta-schemas/core.yaml#

title: MediaTek Functional Clock Controller for MT6757

maintainers:
  - Ben Grisdale <bengris32@protonmail.ch>

description: |
  The clock architecture in MediaTek like below
  PLLs -->
          dividers -->
                      muxes
                           -->
                              clock gate

  The devices provide clock gate control in different IP blocks.

properties:
  compatible:
    items:
      - enum:
        - mediatek,mt6757-camsys
        - mediatek,mt6757-imgsys
        - mediatek,mt6757-mfgcfg
        - mediatek,mt6757-vdecsys
        - mediatek,mt6757-vencsys
      - const: syscon

  reg:
    maxItems: 1

  '#clock-cells':
    const: 1

  '#reset-cells':
    const: 1
    description:
      Reset lines for MFGCFG and VDECSYS blocks

required:
  - compatible
  - reg
  - '#clock-cells'

additionalProperties: false

examples:
  - |
    soc {
        #address-cells = <2>;
        #size-cells = <2>;

        camsys: clock-controller@1a000000 {
            compatible = "mediatek,mt6757-camsys", "syscon";
            reg = <0 0x1a000000 0 0x1000>;
            #clock-cells = <1>;
        };

        imgsys: clock-controller@15020000 {
            compatible = "mediatek,mt6757-imgsys", "syscon";
            reg = <0 0x15020000 0 0x1000>;
            #clock-cells = <1>;
        };

        mfgcfg: clock-controller@13000000 {
            compatible = "mediatek,mt6757-mfgcfg", "syscon";
            reg = <0 0x13000000 0 0x1000>;
            #clock-cells = <1>;
            #reset-cells = <1>;
        };

        vdecsys: clock-controller@16000000 {
            compatible = "mediatek,mt6757-vdecsys", "syscon";
            reg = <0 0x16000000 0 0x1000>;
            #clock-cells = <1>;
            #reset-cells = <1>;
        };

        vencsys: clock-controller@17000000 {
            compatible = "mediatek,mt6757-vencsys", "syscon";
            reg = <0 0x17000000 0 0x1000>;
            #clock-cells = <1>;
        };
    };
```

## Documentation/devicetree/bindings/regulator/mediatek,mt6351-regulator.yaml
```yaml
# SPDX-License-Identifier: (GPL-2.0 OR BSD-2-Clause)
%YAML 1.2
---
$id: http://devicetree.org/schemas/regulator/mediatek,mt6351-regulator.yaml#
$schema: http://devicetree.org/meta-schemas/core.yaml#

title: MT6351 Regulator from MediaTek Integrated

maintainers:
  - Ben Grisdale <bengris32@protonmail.ch>

description: |
  The MT6351 PMIC provides 9 BUCK and 30 LDO (Low Dropout) regulators
  and nodes are named according to the regulator type:
  buck_<name> and ldo_<name>.
  MT6351 regulators node should be sub node of the MT6397 MFD node.

properties:
  compatible:
    const: mediatek,mt6351-regulator

patternProperties:
  "^buck_v(core|gpu|modem|md1|sram_md|s1|s2|pa|sram_proc)$":
    type: object
    $ref: regulator.yaml#

    properties:
      regulator-name:
        pattern: "^v(core|gpu|modem|md1|sram_md|s1|s2|pa|sram_proc)$"

    unevaluatedProperties: false

  "^ldo_v(bif28|usb33|io18|ldo28|io28|ldo28_0|ldo28_1)$":
    type: object
    $ref: regulator.yaml#
    description:
      Properties for single fixed LDO regulator.

    properties:
      regulator-name:
        pattern: "^v(bif28|usb33|io18|ldo28|io28|ldo28_0|ldo28_1)$"

    unevaluatedProperties: false

  "^ldo_v(cama|camd|camio)$":
    type: object
    $ref: regulator.yaml#
    description:
      Properties for single LDO regulator.

    properties:
      regulator-name:
        pattern: "^v(cama|camd|camio)$"

    unevaluatedProperties: false

  "^ldo_v(rf18|rf12|tcxo24|tcxo28|xo22)$":
    type: object
    $ref: regulator.yaml#
    description:
      Properties for single LDO regulator.

    properties:
      regulator-name:
        pattern: "^v(rf18|rf12|tcxo24|tcxo28|xo22)$"

    unevaluatedProperties: false

  "^ldo_v(sim1|sim2|cn18|cn28|cn33)$":
    type: object
    $ref: regulator.yaml#
    description:
      Properties for single LDO regulator.

    properties:
      regulator-name:
        pattern: "^v(sim1|sim2|cn18|cn28|cn33)$"

    unevaluatedProperties: false

  "^ldo_v(dram|emc-3v3|mipi|efuse)$":
    type: object
    $ref: regulator.yaml#
    description:
      Properties for single LDO regulator.

    properties:
      regulator-name:
        pattern: "^v(dram|emc_3v3|mipi|efuse)$"

    unevaluatedProperties: false

  "^ldo_v(io28|gp3|ibr)$":
    type: object
    $ref: regulator.yaml#
    description:
      Properties for single LDO regulator.

    properties:
      regulator-name:
        pattern: "^v(io28|gp3|ibr)$"

    unevaluatedProperties: false

  "^ldo_v(a10|a18|mch|mc)$":
    type: object
    $ref: regulator.yaml#
    description:
      Properties for single LDO regulator.

    properties:
      regulator-name:
        pattern: "^v(a10|a18|mch|mc)$"

    unevaluatedProperties: false

required:
  - compatible

additionalProperties: false

examples:
  - |
    pmic {
      regulators {
        mt6351_vcore_reg: buck_vcore {
          regulator-name = "buck_vcore";
          regulator-min-microvolt = <600000>;
          regulator-max-microvolt = <1393750>;
          regulator-ramp-delay = <6250>;
          regulator-enable-ramp-delay = <180>;
        };

        mt6351_vgpu_reg: buck_vgpu {
          regulator-name = "buck_vgpu";
          regulator-min-microvolt = <600000>;
          regulator-max-microvolt = <1393750>;
          regulator-ramp-delay = <6250>;
          regulator-enable-ramp-delay = <180>;
          regulator-always-on;
          regulator-boot-on;
        };

        mt6351_vmodem_reg: buck_vmodem {
          regulator-name = "buck_vmodem";
          regulator-min-microvolt = <600000>;
          regulator-max-microvolt = <1393750>;
          regulator-ramp-delay = <6250>;
          regulator-enable-ramp-delay = <180>;
          regulator-always-on;
          regulator-boot-on;
        };

        mt6351_vmd1_reg: buck_vmd1 {
          regulator-name = "buck_vmd1";
          regulator-min-microvolt = <600000>;
          regulator-max-microvolt = <1393750>;
          regulator-ramp-delay = <6250>;
          regulator-enable-ramp-delay = <180>;
          regulator-always-on;
          regulator-boot-on;
        };

        mt6351_vsram_md_reg: buck_vsram_md {
          regulator-name = "buck_vsram_md";
          regulator-min-microvolt = <600000>;
          regulator-max-microvolt = <1393750>;
          regulator-ramp-delay = <6250>;
          regulator-enable-ramp-delay = <180>;
          regulator-always-on;
          regulator-boot-on;
        };

        mt6351_vs1_reg: buck_vs1 {
          regulator-name = "buck_vs1";
          regulator-min-microvolt = <600000>;
          regulator-max-microvolt = <1393750>;
          regulator-ramp-delay = <6250>;
          regulator-enable-ramp-delay = <180>;
          regulator-always-on;
          regulator-boot-on;
        };

        mt6351_vs2_reg: buck_vs2 {
          regulator-name = "buck_vs2";
          regulator-min-microvolt = <600000>;
          regulator-max-microvolt = <1393750>;
          regulator-ramp-delay = <6250>;
          regulator-enable-ramp-delay = <180>;
          regulator-always-on;
          regulator-boot-on;
        };

        mt6351_vpa_reg: buck_vpa {
          regulator-name = "buck_vpa";
          regulator-min-microvolt = <600000>;
          regulator-max-microvolt = <1393750>;
          regulator-ramp-delay = <6250>;
          regulator-enable-ramp-delay = <180>;
          regulator-always-on;
          regulator-boot-on;
        };

        mt6351_vsram_proc_reg: buck_vsram_proc {
          regulator-name = "buck_vsram_proc";
          regulator-min-microvolt = <600000>;
          regulator-max-microvolt = <1393750>;
          regulator-ramp-delay = <6250>;
          regulator-enable-ramp-delay = <180>;
          regulator-always-on;
          regulator-boot-on;
        };

        mt6351_va18_reg: ldo_va18 {
          regulator-name = "ldo_va18";
          regulator-min-microvolt = <1800000>;
          regulator-max-microvolt = <1800000>;
          regulator-enable-ramp-delay = <264>;
          regulator-boot-on;
        };

        mt6351_vtcxo24_reg: ldo_vtcxo24 {
          regulator-name = "ldo_vtcxo24";
          regulator-min-microvolt = <1800000>;
          regulator-max-microvolt = <2800000>;
          regulator-enable-ramp-delay = <110>;
          regulator-boot-on;
        };

        mt6351_vtcxo28_reg: ldo_vtcxo28 {
          regulator-name = "ldo_vtcxo28";
          regulator-min-microvolt = <1800000>;
          regulator-max-microvolt = <2800000>;
          regulator-enable-ramp-delay = <110>;
        };

        mt6351_vcn28_reg: ldo_vcn28 {
          regulator-name = "ldo_vcn28";
          regulator-min-microvolt = <1800000>;
          regulator-max-microvolt = <2800000>;
          regulator-enable-ramp-delay = <264>;
        };

        mt6351_vcama_reg: ldo_vcama {
          regulator-name = "ldo_vcama";
          regulator-min-microvolt = <1500000>;
          regulator-max-microvolt = <2800000>;
          regulator-enable-ramp-delay = <264>;
        };

        mt6351_vusb33_reg: ldo_vusb33 {
          regulator-name = "ldo_vusb33";
          regulator-min-microvolt = <3300000>;
          regulator-max-microvolt = <3300000>;
          regulator-enable-ramp-delay = <264>;
          regulator-boot-on;
        };

        mt6351_vsim1_reg: ldo_vsim1 {
          regulator-name = "ldo_vsim1";
          regulator-min-microvolt = <1700000>;
          regulator-max-microvolt = <3100000>;
          regulator-enable-ramp-delay = <264>;
        };

        mt6351_vsim2_reg: ldo_vsim2 {
          regulator-name = "ldo_vsim2";
          regulator-min-microvolt = <1700000>;
          regulator-max-microvolt = <3100000>;
          regulator-enable-ramp-delay = <264>;
        };

        mt6351_vemc_reg: ldo_vemc_3v3 {
          regulator-name = "ldo_vemc_3v3";
          regulator-min-microvolt = <3000000>;
          regulator-max-microvolt = <3300000>;
          regulator-enable-ramp-delay = <44>;
          regulator-boot-on;
        };

        mt6351_vmch_reg: ldo_vmch {
          regulator-name = "ldo_vmch";
          regulator-min-microvolt = <3000000>;
          regulator-max-microvolt = <3300000>;
          regulator-enable-ramp-delay = <44>;
          regulator-boot-on;
        };

        mt6351_vio28_reg: ldo_vio28 {
          regulator-name = "ldo_vio28";
          regulator-min-microvolt = <2800000>;
          regulator-max-microvolt = <2800000>;
          regulator-enable-ramp-delay = <264>;
          regulator-boot-on;
        };

        mt6351_vibr_reg: ldo_vibr {
          regulator-name = "ldo_vibr";
          regulator-min-microvolt = <1200000>;
          regulator-max-microvolt = <3300000>;
          regulator-enable-ramp-delay = <44>;
        };

        mt6351_vcamd_reg: ldo_vcamd {
          regulator-name = "ldo_vcamd";
          regulator-min-microvolt = <900000>;
          regulator-max-microvolt = <1210000>;
          regulator-enable-ramp-delay = <264>;
        };

        mt6351_vrf18_reg: ldo_vrf18 {
          regulator-name = "ldo_vrf18";
          regulator-min-microvolt = <1000000>;
          regulator-max-microvolt = <1810000>;
          regulator-enable-ramp-delay = <220>;
        };

        mt6351_vio18_reg: ldo_vio18 {
          regulator-name = "ldo_vio18";
          regulator-min-microvolt = <1800000>;
          regulator-max-microvolt = <1800000>;
          regulator-enable-ramp-delay = <264>;
          regulator-boot-on;
        };

        mt6351_vcn18_reg: ldo_vcn18 {
          regulator-name = "ldo_vcn18";
          regulator-min-microvolt = <1800000>;
          regulator-max-microvolt = <1800000>;
          regulator-enable-ramp-delay = <44>;
        };

        mt6351_vcamio_reg: ldo_vcamio {
          regulator-name = "ldo_vcamio";
          regulator-min-microvolt = <1200000>;
          regulator-max-microvolt = <1800000>;
          regulator-enable-ramp-delay = <220>;
        };

        mt6351_vxo22_reg: ldo_vxo22 {
          regulator-name = "ldo_vxo22";
          regulator-min-microvolt = <1800000>;
          regulator-max-microvolt = <2800000>;
          regulator-enable-ramp-delay = <110>;
          regulator-boot-on;
        };

        mt6351_vrf12_reg: ldo_vrf12 {
          regulator-name = "ldo_vrf12";
          regulator-min-microvolt = <900000>;
          regulator-max-microvolt = <1200000>;
          regulator-enable-ramp-delay = <220>;
        };

        mt6351_va10_reg: ldo_va10 {
          regulator-name = "ldo_va10";
          regulator-min-microvolt = <900000>;
          regulator-max-microvolt = <1800000>;
          regulator-enable-ramp-delay = <264>;
          regulator-boot-on;
        };

        mt6351_vdram_reg: ldo_vdram {
          regulator-name = "ldo_vdram";
          regulator-min-microvolt = <900000>;
          regulator-max-microvolt = <1210000>;
          regulator-enable-ramp-delay = <264>;
          regulator-boot-on;
        };

        mt6351_vmipi_reg: ldo_vmipi {
          regulator-name = "ldo_vmipi";
          regulator-min-microvolt = <900000>;
          regulator-max-microvolt = <1800000>;
          regulator-enable-ramp-delay = <264>;
        };

        mt6351_vgp3_reg: ldo_vgp3 {
          regulator-name = "ldo_vgp3";
          regulator-min-microvolt = <1000000>;
          regulator-max-microvolt = <1810000>;
          regulator-enable-ramp-delay = <264>;
        };

        mt6351_vbif28_reg: ldo_vbif28 {
          regulator-name = "ldo_vbif28";
          regulator-min-microvolt = <2800000>;
          regulator-max-microvolt = <2800000>;
          regulator-enable-ramp-delay = <264>;
        };

        mt6351_vefuse_reg: ldo_vefuse {
          regulator-name = "ldo_vefuse";
          regulator-min-microvolt = <1200000>;
          regulator-max-microvolt = <2200000>;
          regulator-enable-ramp-delay = <264>;
        };

        mt6351_vcn33_reg: ldo_vcn33 {
          regulator-name = "ldo_vcn33";
          regulator-min-microvolt = <3300000>;
          regulator-max-microvolt = <3600000>;
          regulator-enable-ramp-delay = <264>;
        };

        mt6351_vldo28_reg: ldo_vldo28 {
          regulator-name = "ldo_vldo28";
          regulator-min-microvolt = <2800000>;
          regulator-max-microvolt = <2800000>;
          regulator-enable-ramp-delay = <264>;
        };

        mt6351_vmc_reg: ldo_vmc {
          regulator-name = "ldo_vmc";
          regulator-min-microvolt = <1200000>;
          regulator-max-microvolt = <3300000>;
          regulator-enable-ramp-delay = <44>;
          regulator-boot-on;
        };

        mt6351_vldo28_0_reg: ldo_vldo28_0 {
          regulator-name = "ldo_vldo28_0";
          regulator-min-microvolt = <2800000>;
          regulator-max-microvolt = <2800000>;
          regulator-enable-ramp-delay = <264>;
        };

        mt6351_vldo28_1_reg: ldo_vldo28_1 {
          regulator-name = "ldo_vldo28_1";
          regulator-min-microvolt = <2800000>;
          regulator-max-microvolt = <2800000>;
          regulator-enable-ramp-delay = <264>;
        };
      };
    };
...
```
