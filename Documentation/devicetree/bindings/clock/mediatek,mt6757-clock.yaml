## arch/arm64/configs/checkers_defconfig
```kconfig
CONFIG_ARCH_MEDIATEK=y

CONFIG_COMMON_CLK_MT8163=y
CONFIG_COMMON_CLK_MT8163_AUDSYS=y
CONFIG_COMMON_CLK_MT8163_IMGSYS=y
CONFIG_COMMON_CLK_MT8163_MFGCFG=y
CONFIG_COMMON_CLK_MT8163_MMSYS=y
CONFIG_COMMON_CLK_MT8163_VDECSYS=y
CONFIG_COMMON_CLK_MT8163_VENCSYS=y

CONFIG_PINCTRL_MTK=y
CONFIG_PINCTRL_MT8163=y

CONFIG_SND_SOC_MT8163=y

CONFIG_WATCHDOG=y
CONFIG_MEDIATEK_WATCHDOG=y

CONFIG_USB_GADGET=y
CONFIG_NOP_USB_XCEIV=y
CONFIG_USB_MUSB_HDRC=y
CONFIG_USB_MUSB_MEDIATEK=y
CONFIG_PHY_MTK_TPHY=y

CONFIG_DRM=y
CONFIG_DRM_SIMPLEDRM=y
CONFIG_VT_CONSOLE=y
CONFIG_DRM_FBDEV_EMULATION=y
CONFIG_FRAMEBUFFER_CONSOLE=y
CONFIG_FONTS=y
CONFIG_FONT_8x16=y
CONFIG_LOGO=y
CONFIG_LOGO_LINUX_CLUT224=y
```

## drivers/clk/mediatek/Kconfig
```kconfig
#
# MediaTek SoC drivers
#
config COMMON_CLK_MEDIATEK
	bool
	select MFD_SYSCON
	---help---
	  Mediatek SoCs' clock support.

config COMMON_CLK_MT8135
	bool "Clock driver for Mediatek MT8135"
	depends on ARCH_MEDIATEK || COMPILE_TEST
	select COMMON_CLK_MEDIATEK
	default ARCH_MEDIATEK
	---help---
	  This driver supports Mediatek MT8135 clocks.

config COMMON_CLK_MT8163
	bool "Clock driver for Mediatek MT8163"
	depends on COMMON_CLK
	select COMMON_CLK_MEDIATEK
	default y if MACH_MT8163
	---help---
	  This driver supports Mediatek MT8163 clocks.

config COMMON_CLK_MT8173
	bool "Clock driver for Mediatek MT8173"
	depends on ARCH_MEDIATEK || COMPILE_TEST
	select COMMON_CLK_MEDIATEK
	default ARCH_MEDIATEK
	---help---
	  This driver supports Mediatek MT8173 clocks.
```

## drivers/misc/mediatek/Kconfig
```kconfig
menu "Mediatek Peripherals "
depends on ARM || ARM64

config MTK_PLATFORM
	string "MTK platform name"

config ARCH_MTK_PROJECT
	string "ARCH_MTK_PROJECT"

source "drivers/misc/mediatek/btif/Kconfig"
source "drivers/misc/mediatek/connectivity/Kconfig"

endmenu  # CONN
```

## drivers/staging/amazon/Kconfig
```kconfig
menu "Amazon"

config ROOK
	bool "Rook MTK platform project"
	help
	isolate amazon Rook changes for MTK Platform

config CHECKERS
	bool "Checkers MTK platform project"
	help
	isolate amazon Checkers changes for MTK Platform

config DOUGLAS
	bool "Douglas MTK platform project"
	help
	isolate amazon Douglas changes for MTK Platform

endmenu
```
