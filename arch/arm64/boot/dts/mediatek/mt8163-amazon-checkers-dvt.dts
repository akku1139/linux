// SPDX-License-Identifier: GPL-2.0-only OR MIT
/*
 * Copyright (c) 2025-2026 Ben Grisdale <bengris32@protonmail.ch>
 * Copyright (c) 2025-2026 Jack Matthews <jack@jackmatthe.ws>
 * Copyright (c) 2026 Akari Tsuyukusa <akkun11.open@gmail.com>
 */

/dts-v1/;
#include "mt8163-amazon-checkers.dtsi"

/ {
	/* Needed by stock bootloader */
	version = "dvt";
};
