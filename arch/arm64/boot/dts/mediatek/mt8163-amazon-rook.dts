// SPDX-License-Identifier: GPL-2.0
/*
 * Copyright (c) 2025-2026 Ben Grisdale <bengris32@protonmail.ch>
 */

/dts-v1/;
#include "mt8163-amazon.dtsi"

/ {
	model = "Amazon Echo Spot (2017)";
	compatible = "amazon,rook", "mediatek,mt8163";
	chassis-type = "embedded";
};
