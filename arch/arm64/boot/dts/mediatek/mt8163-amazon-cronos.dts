// SPDX-License-Identifier: GPL-2.0
/*
 * Copyright (c) 2025-2026 Ben Grisdale <bengris32@protonmail.ch>
 */

/dts-v1/;
#include "mt8163-amazon.dtsi"

/ {
	model = "Amazon Echo Show 5 (2021)";
	compatible = "amazon,cronos", "mediatek,mt8163";
	chassis-type = "embedded";
};

&mt6323_vusb_reg {
	regulator-always-on;
};

&u2phy0 {
	status = "okay";
};

&usb0 {
	/* No 5V supply for OTG support. */
	dr_mode = "peripheral";
	status = "okay";
};
